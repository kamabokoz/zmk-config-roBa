## config/west.yml
```yaml
manifest:
  remotes:
    - name: cormoran
      url-base: https://github.com/cormoran
    # 既存のリモートはそのまま維持
  projects:
    # ZMK: DYA Studio 用カスタム RPC サブシステム付き cormoran fork
    - name: zmk
      remote: cormoran
      revision: main+dya
      import: app/west.yml

    # PMW3610ドライバ: DYA Studio診断タブ(センサー診断・フレーム表示)対応版
    # zmk-pmw3610-driverのドロップイン置換(compatible "cormoran,pmw3610"は同一)。併用不可
    - name: zmk-driver-pmw3610-with-custom-studio-rpc
      remote: cormoran
      revision: main
      import: true

    # DYA Studio モジュール（すべて cormoran リポジトリ）
    - name: zmk-module-ble-management
      remote: cormoran
      revision: main
    - name: zmk-module-battery-history
      remote: cormoran
      revision: main
    - name: zmk-module-settings-rpc
      remote: cormoran
      revision: main
    - name: zmk-module-runtime-input-processor
      remote: cormoran
      revision: main
    - name: zmk-behavior-runtime-sensor-rotate
      remote: cormoran
      revision: main
    - name: zmk-feature-runtime-macro
      remote: cormoran
      revision: main
      import: true
    - name: zmk-feature-runtime-combo
      remote: cormoran
      revision: main
      import: true

    # DYA Studio 診断タブ用モジュール
    - name: zmk-feature-device-info
      remote: cormoran
      revision: main
    - name: zmk-feature-watchdog
      remote: cormoran
      revision: main
      import: true
    - name: zmk-feature-kscan-diagnostics
      remote: cormoran
      revision: main
      import: true
  self:
    path: config
```
